/* This file is generated by nds_ldsag (version (2015-08-19) ). */
#include <layout_xip1_ilm_dlm.lds.S>
#define M_FLASH_SECTOR_SIZE     (4K)
#define M_N10_LOOP              (0xD500)
#define M_RAW_SECTOR_SIZE       (SETTING_PARTITION_USER_RAW_SIZE)

#include "memory_control.lds.S"

ENTRY(_start)
EXTERN(retention_boot)
EXTERN(OTA_BOOT)
EXTERN(strdup calloc malloc free realloc _fflush_r _fclose_r fflush printf fopen fread fwrite ftell feof fseek fclose fgets ferror gettimeofday vprintf)
SECTIONS
{
#if (SETTING_SRAM_OPTION == 1) && (CHIP_MAX_MEM == 512)
	_SDA_BASE_ = 0x00100000;
#else
	_SDA_BASE_ = 0x60000000;
#endif
    PROVIDE (__executable_start = 0x00000000);
    NDS_SAG_LMA_ROM = 0x30000000 ;
    FLASH_BEGIN = NDS_SAG_LMA_ROM;

    __xtal                        = XTAL;
    __sys_bus_speed               = SYS_BUS_SPEED;
    __sys_mcu_speed               = SYS_MCU_SPEED;
    __sys_flash_speed             = SYS_FLASH_SPEED;
    __xip_bit                     = XIP_BIT;
    __setting_partition_main_size = SETTING_PARTITION_MAIN_SIZE;
    __setting_flash_total_size    = SETTING_FLASH_TOTAL_SIZE;
    __setting_psram_heap_base     = SETTING_PSRAM_HEAP_BASE;
    __setting_psram_heap_size     = SETTING_PSRAM_HEAP_SIZE;
    __app_xip1                    = ORIGIN(REGION_MAIN1);
    __app_xip2                    = ORIGIN(REGION_MAIN2);
    __fs_start_addr               = ORIGIN(REGION_LAST)+LENGTH(REGION_LAST);
    __img_max_size                = ORIGIN(REGION_LAST)+LENGTH(REGION_LAST)-0x30000000;
    __chip_max_sram               = CHIP_MAX_MEM;
    __fota_option                 = FOTA_OPTION;

    __memory_option               = SETTING_SRAM_OPTION;

    __bsram_addr                  = ORIGIN(REGION_DATA);
    __bsram_size                  = LENGTH(REGION_DATA);

    __lpram_addr                  = ORIGIN(REGION_LPRAM);
    __lpram_size                  = LENGTH(REGION_LPRAM);
    __mcu_suspend_buffer          = ORIGIN(REGION_LPRAM)+LENGTH(REGION_LPRAM)-2048;

    __ota_data                    = ORIGIN(REGION_PARAM);
    g_sa_cfg                      = ORIGIN(REGION_PARAM) + M_FLASH_SECTOR_SIZE;
    g_wifi_cfg                    = ORIGIN(REGION_PARAM) + M_FLASH_SECTOR_SIZE + M_FLASH_SECTOR_SIZE;
    _pad_setting                  = ORIGIN(REGION_PARAM) + M_FLASH_SECTOR_SIZE + M_FLASH_SECTOR_SIZE + M_FLASH_SECTOR_SIZE;
    g_user_cfg                    = ORIGIN(REGION_PARAM) + M_FLASH_SECTOR_SIZE + M_FLASH_SECTOR_SIZE + M_FLASH_SECTOR_SIZE + M_FLASH_SECTOR_SIZE + M_FLASH_SECTOR_SIZE;
#ifdef ANTI_CLONE_PROTECTION
    __acp_1                       = LOADADDR(.prog_in_sram);
    __acp_2                       = SIZEOF(.prog_in_sram);
    __acp_3                       = LOADADDR(.data);
    __acp_4                       = SIZEOF(.data);
#endif

    .magic_boot :
    {
        . = ALIGN(4);
         KEEP(*(.magic_boot_hdr ))
         KEEP(*(.magic_boot ))
         KEEP(*(.magic_boot_c ))
    } > REGION_BURN
    . = 0x00000000;
    SDRAM_BEGIN = .;
    _fast_code_lmastart = LOADADDR (.vector);
    .vector :
    {
        _fast_code_start = .;
         KEEP(*(.vector ))
    } > REGION_TEXT_FAST AT>REGION_BURN
    .nds32_init :
    {
         KEEP(*(.nds32_init )) 
    } > REGION_TEXT_FAST AT>REGION_BURN
    .fast_boot_code :
    {
         *(.fast_boot_code)
         M_CACHE
         M_FAST_BOOT_TEXT_RO
         . = ALIGN(4);
         _fast_code_end = .;
    } > REGION_TEXT_FAST AT>REGION_BURN
//    .rela.text :
//    {
//         *(.rela.text .rela.text.* .rela.gnu.linkonce.t.* ) 
//    } > REGION_TEXT_FAST AT>REGION_BURN
//    .rela.dyn :
//    {
//         *(rela.dyn ) *(.rela__libc_subfreeres ) *(.rela__libc_atexit ) *(.rela__libc_thread_subfreeres ) *(.rela.init_array ) *(.rela.fini_array ) 
//    } > REGION_TEXT_FAST AT>REGION_BURN
    __flash_prog_in_sram_lmastart = LOADADDR(.prog_in_sram);
    .prog_in_sram :
    {
        __flash_prog_in_sram_start = .;
        /*M_ILM */
        M_ILM_TEXT_RO
		*(.copy_to_sram .copy_to_sram.*)
        *(.prog_in_sram .prog_in_sram.*)
        . = ALIGN(4);
        __flash_prog_in_sram_end = .;
    } > REGION_TEXT_FAST AT>REGION_BURN
#if (SETTING_SRAM_OPTION == 1)
    ilm_end = ORIGIN(REGION_TEXT_FAST)+LENGTH(REGION_TEXT_FAST);
    ilm_remain = ilm_end - __flash_prog_in_sram_end;
#else
    ilm_remain = 0;
#endif

    __flash_prog_in_bus_ram_lmastart = LOADADDR(.prog_in_bus_ram);
    .prog_in_bus_ram :
    {
        . = ALIGN(4);
        __flash_prog_in_bus_ram_start = .;
        M_NORMAL_TEXT_RO
        *(.prog_in_bus_ram .prog_in_bus_ram.*)
        . = ALIGN(4);
        M_NORMAL_DATA
        *(.data_in_bus_ram .data_in_bus_ram.*)
        __flash_prog_in_bus_ram_end = .;
    } > REGION_TEXT_NORMAL AT>REGION_BURN
    . = ALIGN(4);
    .text :
    {
        . = ALIGN(4);
        __XIP_TEXT_START = .;
        *(.text .stub .text.* .gnu.linkonce.t.* )
        KEEP(*(.text.*personality* ))
        *(.gnu.warning )
         . = ALIGN(4);
         __XIP_TEXT_END = .;
    } > REGION_BURN
    .rodata :
    {
        *(.rodata .rodata.* .gnu.linkonce.r.* )
    } > REGION_BURN
    .rodata1 :
    {
         *(.rodata1 ) 
    } > REGION_BURN
    .sdata2 :
    {
         *(.sdata2 .sdata2.* .gnu.linkonce.s2.* ) 
    } > REGION_BURN
    .sbss2 :
    {
         *(.sbss2 .sbss2.* .gnu.linkonce.sb2.* ) 
    } > REGION_BURN
    .ex9.itable : 
    {
         *(.ex9.itable ) 
    } > REGION_BURN
    .eh_frame_hdr :
    {
         *(.eh_frame* )
    } > REGION_BURN
    __retention_code_lmastart = LOADADDR(.retention_boot);
    .retention_boot :
    {
        __retention_code_start = .;
         KEEP(*(.retention_boot ))
         *(.allon .allon.* )
         __retention_code_end = .;
    } > REGION_LPRAM AT>REGION_BURN
    //.force_align :
    //{
    //    . = ALIGN(8);
    //} > REGION_DATA_FAST AT>REGION_BURN
    __ble_restore_data_lmastart = LOADADDR(.ble_restore);
    //__ble_restore_data_start = ADDR(.ble_restore);
    .ble_restore : ALIGN(4)
    {
        __ble_restore_data_start = .;
        *(.ble_restore .ble_restore.*)
        __ble_restore_data_end = .;
    } > REGION_DATA_FAST AT>REGION_BURN
    //.force_align1 :
    //{
    //    . = ALIGN(8);
    //} > REGION_DATA_FAST AT>REGION_BURN
    __cxx_lmastart = LOADADDR(.gcc_except_table);
    .gcc_except_table :
    {
        __cxx_start = .;
        KEEP(*(.gcc_except_table )) *(.gcc_except_table.* )
    } > REGION_DATA_FAST AT>REGION_BURN
    __preinit_array_start = .;
    .preinit_array :
    {
        KEEP(*(.preinit_array ))
    } > REGION_DATA_FAST AT>REGION_BURN
    __preinit_array_end = .;
    __init_array_start = .;
    .init_array :
    {
        KEEP(*(.init_array ))
    } > REGION_DATA_FAST AT>REGION_BURN
    __init_array_end = .;
    __fini_array_start = .;
    .fini_array :
    {
        KEEP(*(.fini_array ))
        __cxx_end = .;
    } > REGION_DATA_FAST AT>REGION_BURN
    __fini_array_end = .;
    __ctors_lmastart = LOADADDR(.ctors);
    .ctors : ALIGN(8)
    {
        __ctors_start = .;
#if defined(SUPPORT_CXX) && (SUPPORT_CXX == 1)
        LONG(-1)
#endif
        KEEP(*crtbegin*.o(.ctors)) KEEP(*(EXCLUDE_FILE (*crtend*.o) .ctors)) KEEP(*(SORT(.ctors.* ))) KEEP(*(.ctors ))
        . = ALIGN(8);
    } > REGION_DATA_FAST AT>REGION_BURN
    .dtors : ALIGN(8)
    {
        KEEP(*crtbegin*.o(.dtors)) KEEP(*(EXCLUDE_FILE (*crtend*.o) .dtors)) KEEP(*(SORT(.dtors.* ))) KEEP(*(.dtors ))
        . = ALIGN(8);
    } > REGION_DATA_FAST AT>REGION_BURN
    .tdata :
    {
        *(.tdata .tdata.* .gnu.linkonce.td.* )
    } > REGION_DATA_FAST AT>REGION_BURN
    .data.rel.ro :
    {
        *(.data.rel.ro.local ) *(.data.rel.ro* )
    } > REGION_DATA_FAST AT>REGION_BURN
    .dynamic :
    {
        *(.dynamic )
        __ctors_end = .;
    } > REGION_DATA_FAST AT>REGION_BURN
    __data_lmastart =  LOADADDR (.data);
    .data :
    {
        __data_start = .;
        *(.data .data.* .gnu.linkonce.d.* ) KEEP(*(.gnu.linkonce.d.*personality* )) SORT(CONSTRUCTORS) . = ALIGN(8);
    } > REGION_DATA_FAST AT>REGION_BURN
    .data1 :
    {
        *(.data1 ) . = ALIGN(4);
    } > REGION_DATA_FAST AT>REGION_BURN
    . = ALIGN(4);
    .got :
    {
        *(.got.plt ) *(.got )
    } > REGION_DATA_FAST AT>REGION_BURN
    .sdata_d :
    {
        *(.sdata_d .sdata_d.* )
    } > REGION_DATA_FAST AT>REGION_BURN
    .sdata_w :
    {
        *(.sdata_w .sdata_w.* )
    } > REGION_DATA_FAST AT>REGION_BURN
    .sdata_h :
    {
        *(.sdata_h .sdata_h.* )
    } > REGION_DATA_FAST AT>REGION_BURN
    .sdata_b :
    {
        *(.sdata_b .sdata_b.* )
    } > REGION_DATA_FAST AT>REGION_BURN
    .sdata_f :
    {
        *(.sdata_f .sdata_f.* )
    } > REGION_DATA_FAST AT>REGION_BURN
    . = ALIGN(4);
    __data_end = .;
    __bss_start = .;
    .bss  (NOLOAD) : ALIGN(4)
    {
        *(.tbss .tbss.* .gnu.linkonce.tb.* ) *(.tcommon )
        *(.sbss_f .sbss_f.* ) *(.scommon_f .scommon_f.* )
        *(.sbss_b .sbss_b.* ) *(.scommon_b .scommon_b.* ) . = ALIGN(2);
        *(.sbss_h .sbss_h.* ) *(.scommon_h .scommon_h.* ) . = ALIGN(4);
        *(.sbss_w .sbss_w.* ) *(.scommon_w .scommon_w.* ) *(.dynsbss ) *(.scommon ) . = ALIGN(8);
        *(.sbss_d .sbss_d.* ) *(.scommon_d .scommon_d.* )
        *(.dynbss ) *(.bss .bss.* .gnu.linkonce.b.* ) *(COMMON ) . = ALIGN(4);
    } > REGION_DATA_FAST
    __sbss_end = .;
    ___sbss_end = .;
    . = ALIGN(4);
    __bss_end = .;
    _show_dlm_end = .;

////////////////
    .bss_in_bus_ram (NOLOAD) : ALIGN(4)
    {
        . = ALIGN(4);
        __flash_bss_in_bus_ram_start = .;
        M_NORMAL_BSS
        *(.bss_in_bus_ram .bss_in_bus_ram.*)
        . = ALIGN(4);
        __flash_bss_in_bus_ram_end = .;
    } > REGION_TEXT_NORMAL
////////////////
    bus_ram_end = ORIGIN(REGION_TEXT_NORMAL)+LENGTH(REGION_TEXT_NORMAL);
    bus_ram_remain = bus_ram_end - __flash_bss_in_bus_ram_end;

#ifndef MAIN_STACK_SIZE
#define MAIN_STACK_SIZE            (128*4)
#endif
#ifndef ISR_STACK_SIZE
#define ISR_STACK_SIZE            (128*16)
#endif
    PROVIDE (_stack = ORIGIN(REGION_DATA_FAST)+LENGTH(REGION_DATA_FAST));
	__OS_Exception_Stack = _stack;
    __OS_Int_Stack = __OS_Exception_Stack - (MAIN_STACK_SIZE);
    __fence__ = __OS_Int_Stack - (ISR_STACK_SIZE);
    __isr_stack = ISR_STACK_SIZE;
#if (SETTING_SRAM_OPTION == 1) && (CHIP_MAX_MEM == 512)
    dlm_remain = __fence__ - __bss_end;
#else
    dlm_remain = 0;
#endif
    SDRAM_SIZE = . - SDRAM_BEGIN;
    FLASH_SIZE = LOADADDR(.bss) - FLASH_BEGIN;

    .stab 0 :
    {
         *(.stab) 
    }
    .stabstr 0 :
    {
         *(.stabstr) 
    }
    .stab.excl 0 :
    {
         *(.stab.excl) 
    }
    .stab.exclstr 0 :
    {
         *(.stab.exclstr) 
    }
    .stab.index 0 :
    {
         *(.stab.index) 
    }
    .stab.indexstr 0 :
    {
         *(.stab.indexstr) 
    }
    .note.nds32 0 :
    {
         *(.note.nds32) *(.note.nds32.*) 
    }
    .comment 0 :
    {
         *(.comment) 
    }
    .debug 0 :
    {
         *(.debug) 
    }
    .line 0 :
    {
         *(.line) 
    }
    .debug_srcinfo 0 :
    {
         *(.debug_srcinfo) 
    }
    .debug_sfnames 0 :
    {
         *(.debug_sfnames) 
    }
    .debug_aranges 0 :
    {
         *(.debug_aranges) 
    }
    .debug_pubnames 0 :
    {
         *(.debug_pubnames) 
    }
    .debug_info 0 :
    {
         *(.debug_info .gnu.linkonce.wi.*) 
    }
    .debug_abbrev 0 :
    {
         *(.debug_abbrev) 
    }
    .debug_line 0 :
    {
         *(.debug_line) 
    }
    .debug_frame 0 :
    {
         *(.debug_frame) 
    }
    .debug_str 0 :
    {
         *(.debug_str) 
    }
    .debug_loc 0 :
    {
         *(.debug_loc) 
    }
    .debug_macinfo 0 :
    {
         *(.debug_macinfo) 
    }
    .debug_weaknames 0 :
    {
         *(.debug_weaknames) 
    }
    .debug_funcnames 0 :
    {
         *(.debug_funcnames) 
    }
    .debug_typenames 0 :
    {
         *(.debug_typenames) 
    }
    .debug_varnames 0 :
    {
         *(.debug_varnames) 
    }
}


#if (defined(ROM_VERSION) && (ROM_VERSION != -1))
#include "rom_symbol.sym"
#endif
ASSERT(__fence__ >= (__bss_end + 64), dlm_overflow);
#if (SETTING_SRAM_OPTION == 1)
ASSERT(ilm_remain >= 64, ilm_overflow);
#endif
